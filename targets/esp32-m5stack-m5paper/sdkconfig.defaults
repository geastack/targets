## targets/esp32-s3-m5stack-papers3/main/Kconfig.projbuild
```kconfig
menu "Gea Embedded"

    config GEA_EMBEDDED_PRODUCTION_LOCKDOWN
        bool "Production lockdown"
        default n
        help
            Compile out Gea frame/perf logs, heap diagnostics, and the
            diagnostics server for production firmware.

endmenu
```

## targets/esp32-s3-m5stack-stopwatch/sdkconfig.defaults
```kconfig
CONFIG_IDF_TARGET="esp32s3"
CONFIG_ESPTOOLPY_FLASHSIZE_16MB=y
CONFIG_ESPTOOLPY_FLASHMODE_QIO=y
CONFIG_ESPTOOLPY_FLASHFREQ_80M=y
CONFIG_ESP_CONSOLE_USB_SERIAL_JTAG=y
CONFIG_ESP_CONSOLE_SECONDARY_NONE=y
CONFIG_FREERTOS_HZ=1000
CONFIG_ESP_DEFAULT_CPU_FREQ_MHZ_240=y
CONFIG_ESP_DEFAULT_CPU_FREQ_MHZ=240
CONFIG_ESP_MAIN_TASK_STACK_SIZE=32768
CONFIG_ESP_IPC_TASK_STACK_SIZE=4096
CONFIG_ESP_SYSTEM_EVENT_TASK_STACK_SIZE=4096
CONFIG_PARTITION_TABLE_CUSTOM=y
CONFIG_PARTITION_TABLE_CUSTOM_FILENAME="partitions.csv"
CONFIG_ESP_SYSTEM_PANIC_PRINT_REBOOT=y
CONFIG_SPIRAM=y
CONFIG_SPIRAM_MODE_OCT=y
CONFIG_SPIRAM_SPEED_80M=y
CONFIG_SPIRAM_ALLOW_BSS_SEG_EXTERNAL_MEMORY=y
CONFIG_FREERTOS_TASK_CREATE_ALLOW_EXT_MEM=y
CONFIG_SPIRAM_MALLOC_ALWAYSINTERNAL=0
CONFIG_SPIRAM_MALLOC_RESERVE_INTERNAL=0
CONFIG_COMPILER_OPTIMIZATION_PERF=y
# CONFIG_COMPILER_OPTIMIZATION_DEBUG is not set
CONFIG_LOG_DEFAULT_LEVEL_INFO=y
CONFIG_LOG_DEFAULT_LEVEL=3
CONFIG_LOG_MAXIMUM_EQUALS_DEFAULT=y
CONFIG_LOG_MAXIMUM_LEVEL=3
CONFIG_BOOTLOADER_LOG_LEVEL_INFO=y
CONFIG_BOOTLOADER_LOG_LEVEL=3
CONFIG_COMPILER_OPTIMIZATION_ASSERTIONS_ENABLE=y
CONFIG_COMPILER_OPTIMIZATION_ASSERTION_LEVEL=2
CONFIG_HEAP_TRACING_OFF=y

# Shared network runtime: DTLS/SRTP and device certificate generation.
CONFIG_MBEDTLS_SSL_PROTO_DTLS=y
CONFIG_MBEDTLS_SSL_DTLS_SRTP=y
CONFIG_MBEDTLS_SSL_DTLS_HELLO_VERIFY=y
CONFIG_MBEDTLS_SSL_DTLS_CLIENT_PORT_REUSE=y
CONFIG_MBEDTLS_SSL_DTLS_CONNECTION_ID=y
CONFIG_MBEDTLS_X509_CREATE_C=y
CONFIG_MBEDTLS_X509_CRT_WRITE_C=y
CONFIG_MBEDTLS_X509_CSR_WRITE_C=y

# Native audio/worklet thread-local cleanup needs more than IDF's 1536-byte idle stack.
CONFIG_FREERTOS_IDLE_TASK_STACKSIZE=3072
```

## targets/esp32-s3-touch-lcd-3.5b/main/Kconfig.projbuild
```kconfig
menu "Gea Embedded"

    config GEA_EMBEDDED_PRODUCTION_LOCKDOWN
        bool "Production lockdown"
        default n
        help
            Compile out Gea frame/perf logs, heap diagnostics, and the
            diagnostics server for production firmware. Local development builds
            should leave this disabled so serial monitor and VS Code launch
            tasks show fps and diagnostic logs.

endmenu
```
