#include "services/buttons.h"

#if GEA_BOARD_HAS_BUTTONS
// Generated by the CLI from the board's and the app's "buttons" JSON.
#include "gea_board_buttons.h"
#endif

#if GEA_BOARD_HAS_BUTTONS && GEA_BOARD_BUTTON_COUNT > 0

#include "gpio_pins.h"
#include "input.h"

#include <cstddef>
#include <cstdint>

#include "driver/gpio.h"
#include "esp_attr.h"
#include "esp_log.h"
#include "freertos/FreeRTOS.h"
#include "freertos/task.h"

namespace gea::platform::esp32::buttons {

namespace {

constexpr const char *kTag = "buttons";
constexpr std::size_t kButtonCount = sizeof(board::buttons) / sizeof(board::buttons[0]);
static_assert(kButtonCount <= static_cast<std::size_t>(gea::framework::input::kMaxButtons),
              "the board declares more buttons than input.h's table holds");
static_assert(kButtonCount <= 32, "one notification bit per button");
constexpr int kDebounceMs = 20;
constexpr int kPollMs = 30;
constexpr std::uint32_t kTaskStackBytes = 2560;

int gIds[kButtonCount];
TaskHandle_t gTask = nullptr;
// Settled level per button, owned by the task.
bool gPressed[kButtonCount];

// Idempotent: registerButton returns the existing id for a known code.
void registerAll()
{
	for (std::size_t i = 0; i < kButtonCount; ++i) {
		const Button &button = board::buttons[i];
		gIds[i] = gea::framework::input::registerButton(button.code, button.key, button.keyCode, button.pin);
	}
}

bool watched(const Button &button) { return button.source == Source::Gpio && button.pin >= 0; }

bool readPressed(const Button &button)
{
	return gpio_get_level(static_cast<gpio_num_t>(button.pin)) == button.activeLevel;
}

// An edge disarms its pin and wakes the task with the button's bit; the task
// waits out the bounce, reports the settled level if it changed, and re-arms.
void IRAM_ATTR edge(void *arg)
{
	const auto index = reinterpret_cast<std::uintptr_t>(arg);
	const int pin = board::buttons[index].pin;
	gpio_intr_disable(static_cast<gpio_num_t>(pin));
	// A Gpio or Digital the app opened on this pin rides on this interrupt.
	gea::platform::esp32::gpio::ownedPinEdge(pin);
	BaseType_t woken = pdFALSE;
	xTaskNotifyFromISR(gTask, 1u << index, eSetBits, &woken);
	if (woken) portYIELD_FROM_ISR();
}

void settle(std::size_t index)
{
	const bool pressed = readPressed(board::buttons[index]);
	if (pressed == gPressed[index]) return;
	gPressed[index] = pressed;
	gea::framework::input::queueButton(gIds[index], pressed);
	// The interrupt reported the first edge of the bounce; this is the level
	// it settled on, for a Gpio or Digital that read the pin mid-bounce.
	if (!board::buttons[index].poll) gea::platform::esp32::gpio::ownedPinEdge(board::buttons[index].pin);
	ESP_LOGI(kTag, "%s %s", board::buttons[index].code, pressed ? "down" : "up");
}

void run(void *)
{
	bool polls = false;
	for (std::size_t i = 0; i < kButtonCount; ++i) polls = polls || (watched(board::buttons[i]) && board::buttons[i].poll);
	// Sleeps until an edge; wakes on an interval only when a board button polls.
	const TickType_t wait = polls ? pdMS_TO_TICKS(kPollMs) : portMAX_DELAY;
	while (true) {
		std::uint32_t edges = 0;
		xTaskNotifyWait(0, UINT32_MAX, &edges, wait);
		if (edges) vTaskDelay(pdMS_TO_TICKS(kDebounceMs));
		for (std::size_t i = 0; i < kButtonCount; ++i) {
			const Button &button = board::buttons[i];
			if (!watched(button)) continue;
			if (button.poll) {
				settle(i);
			} else if (edges & (1u << i)) {
				settle(i);
				gpio_intr_enable(static_cast<gpio_num_t>(button.pin));
			}
		}
	}
}

bool configure(std::size_t index)
{
	const Button &button = board::buttons[index];
	const auto pin = static_cast<gpio_num_t>(button.pin);
	// GPIO0 is a strapping pin the bootloader may leave on another function;
	// resetting returns any pin to a plain GPIO matrix entry.
	gpio_reset_pin(pin);
	gpio_config_t config{};
	config.pin_bit_mask = 1ULL << button.pin;
	config.mode = GPIO_MODE_INPUT;
	config.pull_up_en = button.activeLevel == 0 ? GPIO_PULLUP_ENABLE : GPIO_PULLUP_DISABLE;
	config.pull_down_en = button.activeLevel == 0 ? GPIO_PULLDOWN_DISABLE : GPIO_PULLDOWN_ENABLE;
	config.intr_type = button.poll ? GPIO_INTR_DISABLE : GPIO_INTR_ANYEDGE;
	if (gpio_config(&config) != ESP_OK) return false;
	gPressed[index] = readPressed(button);
	gea::platform::esp32::gpio::claimPin(button.pin, !button.poll);
	return true;
}

bool arm(std::size_t index)
{
	const Button &button = board::buttons[index];
	if (button.poll) return true;
	return gpio_isr_handler_add(static_cast<gpio_num_t>(button.pin), edge,
	                            reinterpret_cast<void *>(static_cast<std::uintptr_t>(index))) == ESP_OK;
}

}  // namespace

void start()
{
	registerAll();
	if (gTask) return;
	bool any = false;
	for (std::size_t i = 0; i < kButtonCount; ++i) any = any || watched(board::buttons[i]);
	if (!any) return;
	const esp_err_t service = gpio_install_isr_service(0);
	if (service != ESP_OK && service != ESP_ERR_INVALID_STATE) {
		ESP_LOGE(kTag, "GPIO interrupt service unavailable: %s", esp_err_to_name(service));
		return;
	}
	bool configured[kButtonCount] = {};
	for (std::size_t i = 0; i < kButtonCount; ++i)
		configured[i] = watched(board::buttons[i]) && configure(i);
	if (xTaskCreate(run, "buttons", kTaskStackBytes, nullptr, 5, &gTask) != pdPASS) {
		gTask = nullptr;
		ESP_LOGE(kTag, "task unavailable");
		return;
	}
	for (std::size_t i = 0; i < kButtonCount; ++i) {
		const Button &button = board::buttons[i];
		if (!watched(button)) continue;
		if (configured[i] && arm(i))
			ESP_LOGI(kTag, "%s on GPIO%d (%s, active %s) sends %s",
			         button.code, button.pin, button.poll ? "polled" : "interrupt",
			         button.activeLevel ? "high" : "low", *button.key ? button.key : "no key");
		else
			ESP_LOGE(kTag, "%s on GPIO%d could not be configured", button.code, button.pin);
	}
}

int pmuButton()
{
	// Registers in table order, so the board's buttons list in the order it
	// declares them whichever of start() and the PMU binding runs first.
	int id = -1;
	for (const Button &button : board::buttons) {
		const int registered = gea::framework::input::registerButton(button.code, button.key, button.keyCode, button.pin);
		if (button.source == Source::Pmu && id < 0) id = registered;
	}
	return id;
}

}  // namespace gea::platform::esp32::buttons

#else

void gea::platform::esp32::buttons::start() {}
int gea::platform::esp32::buttons::pmuButton() { return -1; }

#endif
